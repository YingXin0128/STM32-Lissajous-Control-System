#include "menu_chinese.h"
#include "lcd.h"

typedef struct
{
    uint16_t gbk_code;
    uint8_t bitmap[32];
} MenuChineseGlyph;

static const MenuChineseGlyph menu_glyphs[] =
{
    {0xB3CCU, {0x08U,0x00U,0x1DU,0xFCU,0xF1U,0x04U,0x11U,0x04U,0x11U,0x04U,0xFDU,0xFCU,0x10U,0x00U,0x30U,0x00U,0x39U,0xFEU,0x54U,0x20U,0x54U,0x20U,0x91U,0xFCU,0x10U,0x20U,0x10U,0x20U,0x13U,0xFEU,0x10U,0x00U}}, /* U+7A0B */
    {0xBFD8U, {0x10U,0x40U,0x10U,0x20U,0x10U,0x20U,0x13U,0xFEU,0xFAU,0x02U,0x14U,0x94U,0x11U,0x08U,0x1AU,0x04U,0x30U,0x00U,0xD1U,0xFCU,0x10U,0x20U,0x10U,0x20U,0x10U,0x20U,0x10U,0x20U,0x57U,0xFEU,0x20U,0x00U}}, /* U+63A7 */
    {0xCFB5U, {0x00U,0xF8U,0x3FU,0x00U,0x04U,0x00U,0x08U,0x20U,0x10U,0x40U,0x3FU,0x80U,0x01U,0x00U,0x06U,0x10U,0x18U,0x08U,0x7FU,0xFCU,0x01U,0x04U,0x09U,0x20U,0x11U,0x10U,0x21U,0x08U,0x45U,0x04U,0x02U,0x00U}}, /* U+7CFB */
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    {0xB5CDU, {0x08U,0x08U,0x08U,0x3CU,0x0BU,0xE0U,0x12U,0x20U,0x12U,0x20U,0x32U,0x20U,0x32U,0x20U,0x53U,0xFEU,0x92U,0x20U,0x12U,0x10U,0x12U,0x10U,0x12U,0x12U,0x12U,0x0AU,0x12U,0x8AU,0x13U,0x26U,0x12U,0x12U}}, /* U+4F4E */
};

static const uint8_t menu_text_title[] = {0x41U,0x44U,0x39U,0x39U,0x31U,0x30U,0x20U,0xB3U,0xCCU,0xBFU,0xD8U,0xCFU,0xB5U,0xCDU,0xB3U,0x00U};
static const uint8_t menu_text_home_manual[] = {0xCAU,0xD6U,0xB6U,0xAFU,0xC4U,0xA3U,0xCAU,0xBDU,0x00U};
static const uint8_t menu_text_home_auto[] = {0xD7U,0xD4U,0xB6U,0xAFU,0xC4U,0xA3U,0xCAU,0xBDU,0x00U};
static const uint8_t menu_text_home_bypass[] = {0xD6U,0xB1U,0xCDU,0xA8U,0xC4U,0xA3U,0xCAU,0xBDU,0x00U};
static const uint8_t menu_text_footer_nav[] = {0x50U,0x45U,0x31U,0x33U,0xC9U,0xCFU,0x20U,0x20U,0x50U,0x45U,0x31U,0x34U,0xCFU,0xC2U,0x20U,0x20U,0xCDU,0xE2U,0xBDU,0xD3U,0xBCU,0xFCU,0xC8U,0xB7U,0xB6U,0xA8U,0x00U};
static const uint8_t menu_text_title_manual_shape[] = {0xCAU,0xD6U,0xB6U,0xAFU,0x20U,0x2FU,0x20U,0xD0U,0xCEU,0xD7U,0xB4U,0x00U};
static const uint8_t menu_text_shape_diagonal[] = {0xB6U,0xD4U,0xBDU,0xC7U,0xCFU,0xDFU,0x00U};
static const uint8_t menu_text_shape_circle[] = {0xD4U,0xB2U,0x00U};
static const uint8_t menu_text_shape_infinity[] = {0xCEU,0xDEU,0xC7U,0xEEU,0x00U};
static const uint8_t menu_text_footer_back_ok[] = {0x50U,0x45U,0x31U,0x35U,0xB7U,0xB5U,0xBBU,0xD8U,0x20U,0x20U,0xCDU,0xE2U,0xBDU,0xD3U,0xBCU,0xFCU,0xC8U,0xB7U,0xB6U,0xA8U,0x00U};
static const uint8_t menu_text_title_manual_level[] = {0xCAU,0xD6U,0xB6U,0xAFU,0x20U,0x2FU,0x20U,0xB7U,0xF9U,0xB6U,0xC8U,0x00U};
static const uint8_t menu_text_level_4v[] = {0x34U,0x56U,0x20U,0x2DU,0x3EU,0x20U,0x36U,0x36U,0x36U,0x2EU,0x30U,0x20U,0x6DU,0x56U,0x70U,0x70U,0x00U};
static const uint8_t menu_text_level_3v[] = {0x33U,0x56U,0x20U,0x2DU,0x3EU,0x20U,0x35U,0x30U,0x30U,0x2EU,0x30U,0x20U,0x6DU,0x56U,0x70U,0x70U,0x00U};
static const uint8_t menu_text_level_2v[] = {0x32U,0x56U,0x20U,0x2DU,0x3EU,0x20U,0x33U,0x33U,0x33U,0x2EU,0x30U,0x20U,0x6DU,0x56U,0x70U,0x70U,0x00U};
static const uint8_t menu_text_level_1v[] = {0x31U,0x56U,0x20U,0x2DU,0x3EU,0x20U,0x31U,0x36U,0x36U,0x2EU,0x35U,0x20U,0x6DU,0x56U,0x70U,0x70U,0x00U};
static const uint8_t menu_text_footer_back_start[] = {0x50U,0x45U,0x31U,0x35U,0xB7U,0xB5U,0xBBU,0xD8U,0x20U,0x20U,0xCDU,0xE2U,0xBDU,0xD3U,0xBCU,0xFCU,0xC6U,0xF4U,0xB6U,0xAFU,0x00U};
static const uint8_t menu_text_title_manual_run[] = {0xCAU,0xD6U,0xB6U,0xAFU,0xD4U,0xCBU,0xD0U,0xD0U,0x00U};
static const uint8_t menu_text_footer_back_mute[] = {0x50U,0x45U,0x31U,0x35U,0xB7U,0xB5U,0xBBU,0xD8U,0x20U,0x2FU,0x20U,0xCAU,0xE4U,0xB3U,0xF6U,0xB9U,0xD8U,0xB1U,0xD5U,0x00U};
static const uint8_t menu_text_title_auto_shape[] = {0xD7U,0xD4U,0xB6U,0xAFU,0x20U,0x2FU,0x20U,0xD0U,0xCEU,0xD7U,0xB4U,0x00U};
static const uint8_t menu_text_title_auto_mode[] = {0xD7U,0xD4U,0xB6U,0xAFU,0xC4U,0xA3U,0xCAU,0xBDU,0x00U};
static const uint8_t menu_text_selected[] = {0xD2U,0xD1U,0xD1U,0xA1U,0xD4U,0xF1U,0x3AU,0x00U};
static const uint8_t menu_text_not_implemented[] = {0xB9U,0xA6U,0xC4U,0xDCU,0xD4U,0xDDU,0xCEU,0xB4U,0xCAU,0xB5U,0xCFU,0xD6U,0x00U};
static const uint8_t menu_text_reserved[] = {0xD2U,0xD1U,0xD4U,0xA4U,0xC1U,0xF4U,0xC0U,0xA9U,0xD5U,0xB9U,0xBDU,0xD3U,0xBFU,0xDAU,0x00U};
static const uint8_t menu_text_footer_back[] = {0x50U,0x45U,0x31U,0x35U,0xB7U,0xB5U,0xBBU,0xD8U,0x00U};
static const uint8_t menu_text_title_bypass[] = {0xD6U,0xB1U,0xCDU,0xA8U,0xC4U,0xA3U,0xCAU,0xBDU,0x00U};
static const uint8_t menu_text_relay_on[] = {0xBCU,0xCCU,0xB5U,0xE7U,0xC6U,0xF7U,0x3AU,0x20U,0xBFU,0xAAU,0xC6U,0xF4U,0x00U};
static const uint8_t menu_text_pd2_high[] = {0x50U,0x44U,0x32U,0x20U,0x3DU,0x20U,0xB8U,0xDFU,0xB5U,0xE7U,0xC6U,0xBDU,0x00U};
static const uint8_t menu_text_signal_to_scope[] = {0xD0U,0xC5U,0xBAU,0xC5U,0xD6U,0xB1U,0xBDU,0xD3U,0xCBU,0xCDU,0xD6U,0xC1U,0xCAU,0xBEU,0xB2U,0xA8U,0xC6U,0xF7U,0x00U};
static const uint8_t menu_text_footer_relay_off[] = {0x50U,0x45U,0x31U,0x35U,0xB7U,0xB5U,0xBBU,0xD8U,0x20U,0x2FU,0x20U,0xBCU,0xCCU,0xB5U,0xE7U,0xC6U,0xF7U,0xB9U,0xD8U,0xB1U,0xD5U,0x00U};
static const uint8_t menu_text_label_output[] = {0xCAU,0xE4U,0xB3U,0xF6U,0x20U,0x00U};
static const uint8_t menu_text_label_state[] = {0xD7U,0xB4U,0xCCU,0xACU,0x3AU,0x20U,0x00U};
static const uint8_t menu_text_label_raw[] = {0xD4U,0xADU,0xCAU,0xBCU,0x3AU,0x20U,0x00U};
static const uint8_t menu_text_label_used[] = {0xCAU,0xB9U,0xD3U,0xC3U,0x3AU,0x20U,0x00U};
static const uint8_t menu_text_label_target[] = {0xC4U,0xBFU,0xB1U,0xEAU,0x3AU,0x20U,0x00U};
static const uint8_t menu_text_label_command[] = {0xD6U,0xB8U,0xC1U,0xEEU,0x3AU,0x20U,0x00U};
static const uint8_t menu_text_label_feedback[] = {0xB7U,0xB4U,0xC0U,0xA1U,0x3AU,0x20U,0x00U};
static const uint8_t menu_text_label_phase[] = {0xCFU,0xE0U,0xCEU,0xBBU,0x3AU,0x20U,0x00U};
static const uint8_t menu_text_label_correction[] = {0x50U,0x49U,0xD0U,0xDEU,0xD5U,0xFDU,0x3AU,0x20U,0x00U};
static const uint8_t menu_text_label_error[] = {0xCEU,0xF3U,0xB2U,0xEEU,0x3AU,0x20U,0x00U};
static const uint8_t menu_text_label_pll[] = {0x50U,0x4CU,0x4CU,0xCBU,0xF8U,0xB6U,0xA8U,0x3AU,0x20U,0x00U};
static const uint8_t menu_text_state_hold[] = {0xB2U,0xCEU,0xBFU,0xBCU,0xB6U,0xAAU,0xCAU,0xA7U,0x20U,0x2FU,0x20U,0xB1U,0xA3U,0xB3U,0xD6U,0xCAU,0xE4U,0xB3U,0xF6U,0x00U};
static const uint8_t menu_text_state_open_loop[] = {0xBFU,0xAAU,0xBBU,0xB7U,0x00U};
static const uint8_t menu_text_state_closed_loop[] = {0xC6U,0xB5U,0xC2U,0xCAU,0xB1U,0xD5U,0xBBU,0xB7U,0x00U};
static const uint8_t menu_text_state_stopped[] = {0xCDU,0xA3U,0xD6U,0xB9U,0x00U};
static const uint8_t menu_text_high[] = {0xB8U,0xDFU,0x00U};
static const uint8_t menu_text_low[] = {0xB5U,0xCDU,0x00U};

static const uint8_t *const menu_texts[MENU_TEXT_COUNT] =
{
    menu_text_title,
    menu_text_home_manual,
    menu_text_home_auto,
    menu_text_home_bypass,
    menu_text_footer_nav,
    menu_text_title_manual_shape,
    menu_text_shape_diagonal,
    menu_text_shape_circle,
    menu_text_shape_infinity,
    menu_text_footer_back_ok,
    menu_text_title_manual_level,
    menu_text_level_4v,
    menu_text_level_3v,
    menu_text_level_2v,
    menu_text_level_1v,
    menu_text_footer_back_start,
    menu_text_title_manual_run,
    menu_text_footer_back_mute,
    menu_text_title_auto_shape,
    menu_text_title_auto_mode,
    menu_text_selected,
    menu_text_not_implemented,
    menu_text_reserved,
    menu_text_footer_back,
    menu_text_title_bypass,
    menu_text_relay_on,
    menu_text_pd2_high,
    menu_text_signal_to_scope,
    menu_text_footer_relay_off,
    menu_text_label_output,
    menu_text_label_state,
    menu_text_label_raw,
    menu_text_label_used,
    menu_text_label_target,
    menu_text_label_command,
    menu_text_label_feedback,
    menu_text_label_phase,
    menu_text_label_correction,
    menu_text_label_error,
    menu_text_label_pll,
    menu_text_state_hold,
    menu_text_state_open_loop,
    menu_text_state_closed_loop,
    menu_text_state_stopped,
    menu_text_high,
    menu_text_low,
};

static const uint8_t menu_empty_text[] = {0x00U};

static const uint8_t *MenuChinese_FindGlyph(uint16_t gbk_code)
{
    uint16_t index;
    uint16_t count;

    count = (uint16_t)(sizeof(menu_glyphs) / sizeof(menu_glyphs[0]));
    for (index = 0U; index < count; index++)
    {
        if (menu_glyphs[index].gbk_code == gbk_code)
            return menu_glyphs[index].bitmap;
    }
    return 0;
}

static void MenuChinese_DrawGlyph(uint16_t x,
                                  uint16_t y,
                                  uint16_t color,
                                  const uint8_t *bitmap)
{
    uint8_t row;
    uint8_t column;
    uint16_t row_bits;

    if (bitmap == 0)
        return;

    for (row = 0U; row < 16U; row++)
    {
        row_bits = (uint16_t)(((uint16_t)bitmap[row * 2U] << 8) |
                              bitmap[(row * 2U) + 1U]);
        for (column = 0U; column < 16U; column++)
        {
            if ((row_bits & (uint16_t)(0x8000U >> column)) != 0U)
                LCD_Fast_DrawPoint((uint16_t)(x + column),
                                   (uint16_t)(y + row),
                                   color);
        }
    }
}

const uint8_t *MenuChinese_GetText(MenuTextId text_id)
{
    if ((uint16_t)text_id >= (uint16_t)MENU_TEXT_COUNT)
        return menu_empty_text;
    return menu_texts[(uint16_t)text_id];
}

uint16_t MenuChinese_TextWidth(const uint8_t *text)
{
    uint16_t width;

    width = 0U;
    if (text == 0)
        return width;

    while (*text != 0U)
    {
        if (*text < 0x80U)
        {
            width = (uint16_t)(width + 8U);
            text++;
        }
        else if (text[1] != 0U)
        {
            width = (uint16_t)(width + 16U);
            text += 2;
        }
        else
        {
            break;
        }
    }
    return width;
}

uint16_t MenuChinese_DrawText(uint16_t x,
                              uint16_t y,
                              uint16_t right_x,
                              uint16_t color,
                              const uint8_t *text)
{
    uint16_t gbk_code;

    if (text == 0)
        return x;

    while (*text != 0U)
    {
        if (*text < 0x80U)
        {
            if ((uint16_t)(x + 8U) > right_x)
                break;
            if ((*text >= (uint8_t)' ') && (*text <= (uint8_t)'~'))
                LCD_ShowChar(x, y, *text, 16U, color, 1U);
            x = (uint16_t)(x + 8U);
            text++;
        }
        else if (text[1] != 0U)
        {
            if ((uint16_t)(x + 16U) > right_x)
                break;
            gbk_code = (uint16_t)(((uint16_t)text[0] << 8) | text[1]);
            MenuChinese_DrawGlyph(x,
                                  y,
                                  color,
                                  MenuChinese_FindGlyph(gbk_code));
            x = (uint16_t)(x + 16U);
            text += 2;
        }
        else
        {
            break;
        }
    }
    return x;
}
